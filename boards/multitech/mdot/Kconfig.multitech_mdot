## boards/multitech/mdot/Kconfig.multitech_mdot
```kconfig
# Multitech xDot boards configuration


config BOARD_MULTITECH_MDOT
	select SOC_STM32F411XE
```

## boards/multitech/mdot/board.yml
```yaml
board:
  name: multitech_mdot
  vendor: multitech
  socs:
    - name: stm32f411xe
```

## boards/multitech/mdot/multitech_mdot_defconfig
```kconfig
# SPDX-License-Identifier: Apache-2.0

# Enable MPU
CONFIG_ARM_MPU=y

# Enable HW stack protection
CONFIG_HW_STACK_PROTECTION=y

CONFIG_SERIAL=y

CONFIG_SPI=y
CONFIG_SPI_NOR=y

# console
CONFIG_CONSOLE=y
CONFIG_UART_CONSOLE=y

# enable GPIO
CONFIG_GPIO=y

CONFIG_LORAWAN_SYSTEM_MAX_RX_ERROR=20
CONFIG_LORAWAN_SYSTEM_MIN_RX_SYMBOLS=6

CONFIG_RTC_CALIBRATION=y
```

## boards/multitech/xdot/Kconfig.multitech_xdot
```kconfig
# Multitech xDot boards configuration
# SPDX-License-Identifier: Apache-2.0

config BOARD_MULTITECH_XDOT
	select SOC_STM32L151XC
```

## boards/multitech/xdot/board.yml
```yaml
board:
  name: multitech_xdot
  vendor: multitech
  socs:
    - name: stm32l151xc
```

## boards/multitech/xdot/multitech_xdot_defconfig
```kconfig
# Copyright (c) 2024 Multitech Systems Inc.
# SPDX-License-Identifier: Apache-2.0

# Enable MPU
CONFIG_ARM_MPU=y

# enable uart driver
CONFIG_SERIAL=y
# enable console
CONFIG_CONSOLE=y
CONFIG_UART_CONSOLE=y

# enable GPIO
CONFIG_GPIO=y
CONFIG_RTC=y
```

## boards/multitech/xdot_ad/Kconfig.multitech_xdot_ad
```kconfig
# Multitech xDot boards configuration

config BOARD_MULTITECH_XDOT_AD
	select SOC_MAX32670
```

## boards/multitech/xdot_ad/board.yml
```yaml
board:
  name: multitech_xdot_ad
  vendor: multitech
  socs:
    - name: max32670
```

## boards/multitech/xdot_es/Kconfig.multitech_xdot_es
```kconfig
# Multitech xDot boards configuration

config BOARD_MULTITECH_XDOT_ES
	select SOC_MAX32670
```

## boards/multitech/xdot_es/board.yml
```yaml
board:
  name: multitech_xdot_es
  vendor: multitech
  socs:
    - name: max32670
```

## boards/multitech/xdot_es/multitech_xdot_es_defconfig
```kconfig
# Copyright (c) 2024 Multitech Systems Inc.
# SPDX-License-Identifier: Apache-2.0

# Enable GPIO
CONFIG_GPIO=y
CONFIG_RTC=y

# Console
CONFIG_CONSOLE=y
CONFIG_UART_CONSOLE=y

# Enable UART
CONFIG_SERIAL=y
CONFIG_UART_INTERRUPT_DRIVEN=y

CONFIG_SPI=y

# enable pin controller
CONFIG_PINCTRL=y

CONFIG_REBOOT=y
CONFIG_FLASH=y
```

## boards/multitech/xdot_reva/Kconfig.multitech_xdot_reva
```kconfig
# Multitech xDot boards configuration

config BOARD_MULTITECH_XDOT_REVA
	select SOC_MAX32670
```

## boards/multitech/xdot_reva/board.yml
```yaml
board:
  name: multitech_xdot_reva
  vendor: multitech
  socs:
    - name: max32670
```
