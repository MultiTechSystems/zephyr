## boards/multitech/xdot_ad/multitech_xdot_ad_defconfig
```kconfig
# Copyright (c) 2024 Multitech Systems Inc.
# SPDX-License-Identifier: Apache-2.0

# Enable GPIO
CONFIG_GPIO=y
CONFIG_RTC=y

# Console
CONFIG_CONSOLE=y
CONFIG_UART_CONSOLE=y

# CONFIG_LOG_BACKEND_UART=y
# CONFIG_SHELL_LOG_BACKEND=n
# CONFIG_SHELL_BACKEND_SERIAL=y

# Enable UART
CONFIG_SERIAL=y
CONFIG_UART_INTERRUPT_DRIVEN=y

CONFIG_SPI=y

# enable pin controller
CONFIG_PINCTRL=y

CONFIG_REBOOT=y
CONFIG_PM_DEVICE=y
CONFIG_PM_DEVICE_RUNTIME=y
CONFIG_PM_DEVICE_POWER_DOMAIN=y

CONFIG_POWER_DOMAIN=y

# logging options
# CONFIG_POWER_DOMAIN_LOG_LEVEL_DBG=y
# CONFIG_PM_DEVICE_LOG_LEVEL_DBG=y
CONFIG_POWER_DOMAIN_LOG_LEVEL_OFF=y
CONFIG_PM_DEVICE_LOG_LEVEL_OFF=y
```
